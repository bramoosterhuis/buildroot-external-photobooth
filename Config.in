## Config.in
```kconfig
source "$BR2_EXTERNAL_PHOTOBOOTH_PATH/package/gphoto2/Config.in"
source "$BR2_EXTERNAL_PHOTOBOOTH_PATH/package/perl-libimage-exiftool/Config.in"
source "$BR2_EXTERNAL_PHOTOBOOTH_PATH/package/photobooth/Config.in"
source "$BR2_EXTERNAL_PHOTOBOOTH_PATH/package/python-gphoto2/Config.in"
source "$BR2_EXTERNAL_PHOTOBOOTH_PATH/package/libsoup3/Config.in"
source "$BR2_EXTERNAL_PHOTOBOOTH_PATH/package/wpewebkit-extra/Config.in"
```

## configs/raspberrypi3_64_photobooth_defconfig
```kconfig
BR2_aarch64=y
BR2_ARM_FPU_VFPV4=y
BR2_PACKAGE_HOST_LINUX_HEADERS_CUSTOM_5_15=y
BR2_TOOLCHAIN_BUILDROOT_CXX=y
BR2_PACKAGE_HOST_GDB=y
BR2_PACKAGE_HOST_GDB_TUI=y
BR2_CCACHE=y
BR2_ENABLE_DEBUG=y
BR2_DEBUG_3=y
BR2_OPTIMIZE_G=y
BR2_GLOBAL_PATCH_DIR="${BR2_EXTERNAL_PHOTOBOOTH_PATH}/patches"
BR2_TARGET_GENERIC_ISSUE="Welcome the PhotoBooth"
BR2_ROOTFS_DEVICE_CREATION_DYNAMIC_EUDEV=y
BR2_TARGET_GENERIC_ROOT_PASSWD="booth"
BR2_SYSTEM_DHCP="eth0"
BR2_ROOTFS_POST_BUILD_SCRIPT="board/raspberrypi3-64/post-build.sh"
BR2_ROOTFS_POST_IMAGE_SCRIPT="board/raspberrypi3-64/post-image.sh"
BR2_LINUX_KERNEL=y
BR2_LINUX_KERNEL_CUSTOM_TARBALL=y
BR2_LINUX_KERNEL_CUSTOM_TARBALL_LOCATION="$(call github,raspberrypi,linux,3f4092766eaf692ed79b69f59c98dbe38e557fe7)/linux-3f4092766eaf692ed79b69f59c98dbe38e557fe7.tar.gz"
BR2_LINUX_KERNEL_DEFCONFIG="bcmrpi3"
BR2_LINUX_KERNEL_CONFIG_FRAGMENT_FILES="${BR2_EXTERNAL_PHOTOBOOTH_PATH}/board/common/kernel/disable-module-compression.fragment"
BR2_LINUX_KERNEL_DTS_SUPPORT=y
BR2_LINUX_KERNEL_INTREE_DTS_NAME="broadcom/bcm2710-rpi-3-b broadcom/bcm2710-rpi-3-b-plus broadcom/bcm2837-rpi-3-b"
BR2_LINUX_KERNEL_NEEDS_HOST_OPENSSL=y
BR2_PACKAGE_ALSA_UTILS=y
BR2_PACKAGE_ALSA_UTILS_ALSACONF=y
BR2_PACKAGE_ALSA_UTILS_ACONNECT=y
BR2_PACKAGE_ALSA_UTILS_ALSALOOP=y
BR2_PACKAGE_ALSA_UTILS_AMIXER=y
BR2_PACKAGE_ALSA_UTILS_APLAY=y
BR2_PACKAGE_ALSA_UTILS_SPEAKER_TEST=y
BR2_PACKAGE_FFMPEG_NONFREE=y
BR2_PACKAGE_FFMPEG_FFPLAY=y
BR2_PACKAGE_FFMPEG_FFPROBE=y
BR2_PACKAGE_GST1_PLUGINS_BASE_INSTALL_TOOLS=y
BR2_PACKAGE_GST1_PLUGINS_BASE_PLUGIN_ADDER=y
BR2_PACKAGE_GST1_PLUGINS_BASE_PLUGIN_AUDIOMIXER=y
BR2_PACKAGE_GST1_PLUGINS_BASE_PLUGIN_AUDIORATE=y
BR2_PACKAGE_GST1_PLUGINS_BASE_PLUGIN_AUDIOTESTSRC=y
BR2_PACKAGE_GST1_PLUGINS_BASE_PLUGIN_RAWPARSE=y
BR2_PACKAGE_GST1_PLUGINS_BASE_PLUGIN_SUBPARSE=y
BR2_PACKAGE_GST1_PLUGINS_BASE_PLUGIN_VIDEOTESTSRC=y
BR2_PACKAGE_GST1_PLUGINS_BASE_LIB_OPENGL=y
BR2_PACKAGE_GST1_PLUGINS_BASE_PLUGIN_TREMOR=y
BR2_PACKAGE_GST1_PLUGINS_BASE_PLUGIN_OGG=y
BR2_PACKAGE_GST1_PLUGINS_BASE_PLUGIN_OPUS=y
BR2_PACKAGE_GST1_PLUGINS_BASE_PLUGIN_THEORA=y
BR2_PACKAGE_GST1_PLUGINS_BASE_PLUGIN_VORBIS=y
BR2_PACKAGE_GST1_PLUGINS_GOOD_JPEG=y
BR2_PACKAGE_GST1_PLUGINS_GOOD_PLUGIN_ALPHA=y
BR2_PACKAGE_GST1_PLUGINS_GOOD_PLUGIN_V4L2=y
BR2_PACKAGE_GST1_PLUGINS_GOOD_PLUGIN_V4L2_PROBE=y
BR2_PACKAGE_GST1_PLUGINS_BAD_PLUGIN_KMS=y
BR2_PACKAGE_GST1_PLUGINS_BAD_PLUGIN_WEBRTC=y
BR2_PACKAGE_GST1_PLUGINS_BAD_PLUGIN_WEBRTCDSP=y
BR2_PACKAGE_GST1_PLUGINS_BAD_PLUGIN_V4L2CODECS=y
BR2_PACKAGE_GST1_PLUGINS_UGLY=y
BR2_PACKAGE_GST1_PYTHON=y
BR2_PACKAGE_GST1_RTSP_SERVER=y
BR2_PACKAGE_PIPEWIRE=y
BR2_PACKAGE_PIPEWIRE_EXAMPLES=y
BR2_PACKAGE_PIPEWIRE_GSTREAMER=y
BR2_PACKAGE_PIPEWIRE_V4L2=y
BR2_PACKAGE_PIPEWIRE_MEDIA_SESSION=y
BR2_PACKAGE_V4L2GRAB=y
BR2_PACKAGE_V4L2LOOPBACK=y
BR2_PACKAGE_V4L2LOOPBACK_UTILS=y
BR2_PACKAGE_ZSTD=y
BR2_PACKAGE_GDB=y
BR2_PACKAGE_COMIX_CURSORS=y
BR2_PACKAGE_OBSIDIAN_CURSORS=y
BR2_PACKAGE_BITSTREAM_VERA=y
BR2_PACKAGE_COG=y
BR2_PACKAGE_COG_PLATFORM_DRM=y
BR2_PACKAGE_COG_USE_SYSTEM_DBUS=y
BR2_PACKAGE_MESA3D=y
BR2_PACKAGE_MESA3D_GALLIUM_DRIVER_V3D=y
BR2_PACKAGE_MESA3D_OPENGL_ES=y
BR2_PACKAGE_WESTON=y
# BR2_PACKAGE_WESTON_SHELL_IVI is not set
BR2_PACKAGE_WESTON_DEMO_CLIENTS=y
BR2_PACKAGE_RPI_FIRMWARE=y
BR2_PACKAGE_RPI_FIRMWARE_BOOTCODE_BIN=y
BR2_PACKAGE_RPI_FIRMWARE_VARIANT_PI=y
BR2_PACKAGE_RPI_FIRMWARE_CONFIG_FILE="${BR2_EXTERNAL_PHOTOBOOTH_PATH}/board/photobooth/config_3_64bit.txt"
BR2_PACKAGE_USBMOUNT=y
BR2_PACKAGE_PHP_EXT_BZIP2=y
BR2_PACKAGE_PHP_EXT_PHAR=y
BR2_PACKAGE_PHP_EXT_OPENSSL=y
BR2_PACKAGE_PHP_EXT_EXIF=y
BR2_PACKAGE_PHP_EXT_CURL=y
BR2_PACKAGE_PYTHON3_BZIP2=y
BR2_PACKAGE_PYTHON3_DECIMAL=y
BR2_PACKAGE_PYTHON3_READLINE=y
BR2_PACKAGE_PYTHON3_SSL=y
BR2_PACKAGE_PYTHON3_SQLITE=y
BR2_PACKAGE_PYTHON3_PYEXPAT=y
BR2_PACKAGE_PYTHON3_XZ=y
BR2_PACKAGE_PYTHON3_ZLIB=y
BR2_PACKAGE_PYTHON_PIEXIF=y
BR2_PACKAGE_PYTHON_PSUTIL=y
BR2_PACKAGE_PYTHON_PYZMQ=y
BR2_PACKAGE_ALSA_LIB_PYTHON=y
BR2_PACKAGE_ALSA_PLUGINS=y
BR2_PACKAGE_LIBSNDFILE=y
BR2_PACKAGE_CA_CERTIFICATES=y
BR2_PACKAGE_POSTGRESQL=y
BR2_PACKAGE_ATK=y
BR2_PACKAGE_CAIRO_PS=y
BR2_PACKAGE_CAIRO_SVG=y
BR2_PACKAGE_GD_ANNOTATE=y
BR2_PACKAGE_GD_GD2COPYPAL=y
BR2_PACKAGE_GD_GD2TOGIF=y
BR2_PACKAGE_GD_GD2TOPNG=y
BR2_PACKAGE_GD_GDCMPGIF=y
BR2_PACKAGE_GD_GDPARTTOPNG=y
BR2_PACKAGE_GD_GDTOPNG=y
BR2_PACKAGE_GD_GIFTOGD2=y
BR2_PACKAGE_GD_PNGTOGD=y
BR2_PACKAGE_GD_PNGTOGD2=y
BR2_PACKAGE_GD_WEBPNG=y
BR2_PACKAGE_GDK_PIXBUF=y
BR2_PACKAGE_LCMS2=y
BR2_PACKAGE_WAYLAND_UTILS=y
BR2_PACKAGE_WOFF2=y
BR2_PACKAGE_WPEWEBKIT=y
BR2_PACKAGE_WPEWEBKIT_MULTIMEDIA=y
BR2_PACKAGE_WPEWEBKIT_MEDIA_STREAM=y
BR2_PACKAGE_LIBV4L_UTILS=y
BR2_PACKAGE_C_ARES=y
BR2_PACKAGE_LIBCURL_CURL=y
BR2_PACKAGE_LIBUV=y
BR2_PACKAGE_QPDF=y
BR2_PACKAGE_MODSECURITY2=y
BR2_PACKAGE_DROPBEAR=y
BR2_PACKAGE_NTP=y
BR2_PACKAGE_NTP_NTPDATE=y
BR2_PACKAGE_XXHASH=y
BR2_PACKAGE_UTIL_LINUX_MOUNT=y
BR2_TARGET_ROOTFS_EXT2=y
BR2_TARGET_ROOTFS_EXT2_4=y
BR2_TARGET_ROOTFS_EXT2_SIZE="1000M"
# BR2_TARGET_ROOTFS_TAR is not set
BR2_PACKAGE_HOST_DOSFSTOOLS=y
BR2_PACKAGE_HOST_GENIMAGE=y
BR2_PACKAGE_HOST_MTOOLS=y
BR2_PACKAGE_HOST_NODEJS=y
BR2_PACKAGE_PHOTOBOOTH=y
BR2_PACKAGE_LIBSOUP3_SSL=y
```

## package/gphoto2/Config.in
```kconfig
config BR2_PACKAGE_GPHOTO2
    bool "gphoto2"
    select BR2_PACKAGE_LIBGPHOTO2
    select BR2_PACKAGE_POPT
    help
        The gphoto2 commandline tool for accessing and 
        controlling digital cameras.

        http://gphoto.org/proj/gphoto2/
```

## package/photobooth/Config.in
```kconfig
#TODO add 

config BR2_PACKAGE_PHOTOBOOTH
    bool "photobooth"
    depends on BR2_ENABLE_LOCALE
    select BR2_PACKAGE_APACHE
    select BR2_PACKAGE_CUPS
    select BR2_PACKAGE_EXIFTOOL
    select BR2_PACKAGE_GD
    select BR2_PACKAGE_GPHOTO2
    select BR2_PACKAGE_FFMPEG
    select BR2_PACKAGE_FFMPEG_GPL
    select BR2_PACKAGE_PHP
    select BR2_PACKAGE_PHP_SAPI_APACHE
    select BR2_PACKAGE_PHP_SAPI_FPM
    select BR2_PACKAGE_PHP_SAPI_CLI
    select BR2_PACKAGE_PHP_SAPI_CGI
    select BR2_PACKAGE_PHP_EXT_ZIP
    select BR2_PACKAGE_PHP_EXT_GD
    select BR2_PACKAGE_PYTHON3
    select BR2_PACKAGE_PYTHON_GPHOTO2
    select BR2_PACKAGE_LOCKDEV
    select BR2_PACKAGE_LIBEXIF
    select BR2_PACKAGE_LIBCURL
    select BR2_PACKAGE_LIBGPHOTO2
    select BR2_PACKAGE_RSYNC
    select BR2_PACKAGE_UDISKS
    select BR2_PACKAGE_UDISKS_FHS_MEDIA
    select BR2_PACKAGE_X264
    help
        OpenSource Photobooth Webinterface 

        https://photoboothproject.github.io/
        
comment "photobooth needs a toolchain w/ wchar and locale enabled"
	depends on !BR2_ENABLE_LOCALE
```

## package/python-gphoto2/Config.in
```kconfig
config BR2_PACKAGE_PYTHON_GPHOTO2
	bool "python-gphoto2"
	help
	  python-gphoto2 is a comprehensive Python interface (or binding) to 
	  libgphoto2. 

	  https://github.com/jim-easterbrook/python-gphoto2
```
